// Elnaz Rezaee 98411387

#include <mega32.h>
#include <delay.h>

unsigned char CODE[]= {
    0x00,    //    0002        . . . . . . . . 
    0x00,    //    0003        . . . . . . . . 
    0x00,    //    0004        . . . . . . . . 
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    0x00,    //    0047        . . . . . . . . 
    };

unsigned char PORT[16] = {1, 2, 4, 8, 16, 32, 64, 128, 0, 0, 0, 0, 0, 0, 0, 0};
unsigned int s, col, timer;

void main(void) {


    PORTB=0x00;
    DDRB=0xFF; 
    
    PORTC=0x00;
    DDRC=0xFF;
    
    PORTD=0x00;
    DDRD=0xFF;

    while(1) {  
        for(s=8; s<72; s++) {
            for(timer=0; timer<4; timer++) {    
                for (col=0;col<16;col++) {   
                    POsRTB = PORT[col];
                    PORTC = ~CODE[s+col];       
                    delay_ms(1);    
                }
                 
                delay_ms(2);
                
                for (col=0; col<16; col++) {   
                    PORTD = PORT[col];
                    PORTC = ~CODE[s+col-8];        
                    delay_ms(1);
                }
            }
        }
    };
}
